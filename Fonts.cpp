#include "Fonts.h"

// Normal font data (80 characters, 5 columns each)
const int font_count = 80;

const uint8_t myfont[80][5] PROGMEM = {
  {0, 0, 0, 0, 0}, // 0: space
  {0x7E,0x11,0x11,0x11,0x7E}, // 1: A
  {0x7F,0x49,0x49,0x49,0x36}, // 2: B
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  {0x11, 0x13, 0x15, 0x19, 0x11}, // 66: z
  
 // 67: Heart
  {0x00, 0x0A, 0x1F, 0x0E, 0x04},
  
  // 68: Smiley Face
  {0x3E, 0x41, 0x95, 0x89, 0x3E},
  
  // 69: Arrow Right
  {0x00, 0x04, 0x06, 0x7F, 0x00},
  
  // 70: Arrow Left
  {0x00, 0x20, 0x60, 0x7F, 0x00},
  
  // 71: Arrow Up
  {0x04, 0x0E, 0x1F, 0x04, 0x04},
  
  // 72: Arrow Down
  {0x04, 0x04, 0x1F, 0x0E, 0x04},
  
  // 73: Star
  {0x04, 0x0E, 0x1F, 0x0E, 0x04},
  
  // 74: Check Mark
  {0x00, 0x01, 0x02, 0x44, 0x38},
  
  // 75: X Mark
  {0x63, 0x14, 0x08, 0x14, 0x63},
  
  // 76: Music Note
  {0x06, 0x0E, 0x1E, 0x3E, 0x1C},
  
  // 77: Battery Full
  {0x7F, 0x41, 0x5D, 0x5D, 0x41},
  
  // 78: WiFi Symbol
  {0x00, 0x70, 0x08, 0x70, 0x00},

};

// Big font data (10 characters, 20 columns each)
const int bigfont_count = 10;

const uint8_t mybigfont[10][20] PROGMEM = {
   {0x3F,0x7F,0xE0,0xC1,0xC3,0xC7,0xCE,0xFC,0x7F,0x3F,0xF0,0xF8,0xFC,0xCC,0x8C,0xC,0xC,0x3C,0xF8,0xF0}, //0
   {0x0,0x0,0x30,0x70,0xFF,0xFF,0x0,0x0,0x0,0x0,0x0,0x0,0xC,0xC,0xFC,0xFC,0xC,0xC,0x0,0x0},
   {0x30,0x70,0xE0,0xC0,0xC0,0xC1,0xC3,0xE7,0x7E,0x3C,0xC,0x1C,0x3C,0x7C,0xEC,0xCC,0x8C,0xC,0xC,0xC},
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   {0x3C,0x7E,0xE7,0xC3,0xC3,0xC3,0xC3,0xC3,0x7F,0x3F,0x10,0x18,0x1C,0xC,0xC,0xC,0xC,0x1C,0xF8,0xF0}
};

// Tiny font data (42 characters, 3 columns each)
const int tinyfont_count = 42;

const uint16_t mytinyfont[42][3] PROGMEM = {
   //a-z
   {0, 0, 0}   // space!   
  ,{0x1F, 0x14, 0x1F}  // a
  ,{0x1F, 0x15, 0xA}   // b
  ,{0x1F, 0x11, 0x11}  // c
  ,{0x1F, 0x11, 0xE}   // d
  ,{0x1F, 0x15, 0x11}  // e
  ,{0x1F, 0x14, 0x10}  // f
  ,{0x1F, 0x11, 0x17}  // g
  ,{0x1F, 0x4,  0x1F}  // h
  ,{0x11, 0x1F, 0x11}  // i
  ,{0x3,  0x1,  0x1F}  // j
  ,{0x1F, 0x4,  0x1B}  // k
  ,{0x1F, 0x1,  0x1}   // l
  ,{0x1F, 0x8,  0x1F}  // m
  ,{0x1F, 0x10, 0xF}   // n
  ,{0x1F, 0x11, 0x1F}  // o
  ,{0x1F, 0x14, 0x1C}  // p
  ,{0x1C, 0x14, 0x1F}  // q
  ,{0x1F, 0x16, 0x1D}  // r
  ,{0x1D, 0x15, 0x17}  // s
  ,{0x10, 0x1F, 0x10}  // t
  ,{0x1F, 0x1,  0x1F}  // u
  ,{0x1E, 0x1,  0x1E}  // v
  ,{0x1F, 0x2,  0x1F}  // w
  ,{0x1B, 0x4,  0x1B}  // x
  ,{0x1C, 0x7,  0x1C}  // y
  ,{0x13, 0x15, 0x19}  // z
  
  ,{0x01, 0x00, 0x00}  // 27: .
  ,{0x00, 0x0A, 0x00}  // 28: :
  ,{0x18, 0x00, 0x00}  // 29: '
  ,{0x1D, 0x00, 0x00}  // 30: !
  ,{0x10, 0x15, 0x1C}  // 31: ?
  
  ,{0x1F, 0x11, 0x1F}  // 32: 0
  ,{0x00, 0x00, 0x1F}  // 33: 1
  ,{0x17, 0x15, 0x1D}  // 34: 2
  ,{0x11, 0x15, 0x1F}  // 35: 3
  ,{0x1C, 0x4,  0x1F}  // 36: 4
  ,{0x1D, 0x15, 0x17}  // 37: 5
  ,{0x1F, 0x15, 0x17}  // 38: 6
  ,{0x10, 0x10, 0x1F}  // 39: 7
  ,{0x1F, 0x15, 0x1F}  // 40: 8
  ,{0x1D, 0x15, 0x1F}  // 41: 9
};

// Helper functions
void getNormalFontChar(char c, uint8_t* buffer) {
    int index = 0;
    
    if (c == ' ') {
        index = 0;
    }
    else if (c >= 'A' && c <= 'Z') {
        index = c - 'A' + 1;  // A=1, B=2, ... Z=26
    }
    else if (c >= '0' && c <= '9') {
        index = 31 + (c - '0');  // 0=31, 1=32, ... 9=40
    }
    else if (c >= 'a' && c <= 'z') {
        index = 41 + (c - 'a');  // a=41, b=42, ... z=66
    }
    else if (c == '.') {
        index = 27;
    }
    else if (c == '\'') {
        index = 28;
    }
    else if (c == ':') {
        index = 29;
    }
    else {
        index = 0;  // Default to space
    }
    
    // Ensure index is within bounds
    if (index < 0 || index >= 80) {
        index = 0;
    }
    
    for (int i = 0; i < 5; i++) {
        buffer[i] = pgm_read_byte(&myfont[index][i]);
    }
}

void getBigFontChar(int num, uint8_t* buffer) {
    if (num < 0 || num >= 10) return;
    
    for (int i = 0; i < 20; i++) {
        buffer[i] = pgm_read_byte(&mybigfont[num][i]);
    }
}

void getTinyFontChar(char c, uint16_t* buffer) {
    int index = 0;
    
    if (c == ' ') {
        index = 0;
    }
    else if (c >= 'a' && c <= 'z') {
        index = c - 'a' + 1;  // a=1, b=2, ... z=26
    }
    else if (c >= '0' && c <= '9') {
        index = 32 + (c - '0');  // 0=32, 1=33, ... 9=41
    }
    else if (c == '.') {
        index = 27;
    }
    else if (c == ':') {
        index = 28;
    }
    else if (c == '\'') {
        index = 29;
    }
    else if (c == '!') {
        index = 30;
    }
    else if (c == '?') {
        index = 31;
    }
    else {
        index = 0;
    }
    
    // Ensure index is within bounds
    if (index < 0 || index >= 42) {
        index = 0;
    }
    
    for (int i = 0; i < 3; i++) {
        buffer[i] = pgm_read_word(&mytinyfont[index][i]);
    }
}